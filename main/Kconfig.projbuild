## main/Kconfig.projbuild
```kconfig
menu "WiFi Configuration"
    config WIFI_SSID
        string "WiFi SSID"
        default ""
        help
            WiFi network name to connect to.
    config WIFI_PASSWORD
        string "WiFi Password"
        default ""
        help
            WiFi network password.
endmenu

menu "Home Assistant"
    config HA_BASE_URL
        string "Home Assistant base URL"
        default ""
        help
            The base URL of the Home Assistant instance (e.g., https://homeassistant.local:8123).
    config HA_TOKEN
        string "Home Assistant access token"
        default ""
        help
            Long-lived access token used for Home Assistant API authentication.

    config HA_FILTER_AREA
        string "Area filter (leave blank to show all entities)"
        default ""
        help
            If set, only entities belonging to this Home Assistant area are shown on
            the touch panel. Enter the area name exactly as it appears in HA
            (case-insensitive). Example: "Office" or "Living Room".
            Leave blank to show all supported entities from every area.

    config HA_ENTITY_SKIP_NUMBERED
        bool "Hide numbered light variants (e.g. 'Office Light 1')"
        default y
        help
            When enabled, lights whose friendly name ends with a digit are hidden.
            These are usually individual bulbs already covered by a group toggle.

    config HA_ENTITY_SKIP_LIGHT_KEYWORDS
        string "Lights page: comma-separated keywords to hide"
        default ""
        help
            Case-insensitive substrings. Any light whose friendly name contains one
            of these keywords is hidden from the Lights page.
            Example: "desk,lamp,strip,accent"

    config HA_ENTITY_SKIP_TEMP_KEYWORDS
        string "Temperature page: comma-separated keywords to hide"
        default ""
        help
            Case-insensitive substrings to filter out of the Temperature page.
            Example: "rack,fireplace light,dining room light,office lights"

    config HA_ENTITY_SKIP_OCC_KEYWORDS
        string "Occupancy page: comma-separated keywords to hide"
        default ""
        help
            Case-insensitive substrings to filter out of the Occupancy page.
            Example: "doorbell,garage"
endmenu

menu "Example Configuration"

    menu "Display"
        config EXAMPLE_LCD_RGB_BOUNCE_BUFFER_HEIGHT
            int "RGB Bounce buffer height"
            default 10
            help
                Height of bounce buffer. The width of the buffer is the same as that of the LCD.

        config EXAMPLE_LVGL_PORT_TASK_MAX_DELAY_MS
            int "LVGL timer task maximum delay (ms)"
            default 500
            range 2 2000  # Example range, adjust as needed
            help
            The maximum delay of the LVGL timer task, in milliseconds.

        config EXAMPLE_LVGL_PORT_TASK_MIN_DELAY_MS
            int "LVGL timer task minimum delay (ms)"
            default 10
            range 1 100  # Example range, adjust as needed
            help
            The minimum delay of the LVGL timer task, in milliseconds.

        config EXAMPLE_LVGL_PORT_TASK_PRIORITY
            int "LVGL task priority"
            default 5
            help
                The Board Support Package will create a task that will periodically handle LVGL operation in lv_timer_handler().

        config EXAMPLE_LVGL_PORT_TASK_STACK_SIZE_KB
            int "LVGL task stack size (KB)"
            default 6
            help
                Size(KB) of LVGL task stack.

        config EXAMPLE_LVGL_PORT_TASK_CORE
            int "LVGL timer task core"
            default -1
            range -1 1
            help
            The core of the LVGL timer task.
            Set to -1 to not specify the core.
            Set to 1 only if the SoCs support dual-core, otherwise set to -1 or 0.

        config EXAMPLE_LVGL_PORT_TICK
            int "LVGL tick period"
            default 2
            range 1 100
            help
                Period of LVGL tick timer.

        config EXAMPLE_LVGL_PORT_AVOID_TEAR_ENABLE
            bool "Avoid tearing effect"
            default "n"
            help
                Avoid tearing effect through LVGL buffer mode and double frame buffers of RGB LCD. This feature is only available for RGB LCD.

        choice
            depends on EXAMPLE_LVGL_PORT_AVOID_TEAR_ENABLE
            prompt "Select Avoid Tearing Mode"
            default EXAMPLE_LVGL_PORT_AVOID_TEAR_MODE_3
            config EXAMPLE_LVGL_PORT_AVOID_TEAR_MODE_1
                bool "Mode1: LCD double-buffer & LVGL full-refresh"
            config EXAMPLE_LVGL_PORT_AVOID_TEAR_MODE_2
                bool "Mode2: LCD triple-buffer & LVGL full-refresh"
            config EXAMPLE_LVGL_PORT_AVOID_TEAR_MODE_3
                bool "Mode3: LCD double-buffer & LVGL direct-mode"
            help
                The current tearing prevention mode supports both full refresh mode and direct mode. Tearing prevention mode may consume more PSRAM space
        endchoice

        config EXAMPLE_LVGL_PORT_AVOID_TEAR_MODE
            depends on EXAMPLE_LVGL_PORT_AVOID_TEAR_ENABLE
            int
            default 1 if EXAMPLE_LVGL_PORT_AVOID_TEAR_MODE_1
            default 2 if EXAMPLE_LVGL_PORT_AVOID_TEAR_MODE_2
            default 3 if EXAMPLE_LVGL_PORT_AVOID_TEAR_MODE_3

        choice
            depends on EXAMPLE_LVGL_PORT_AVOID_TEAR_ENABLE
            prompt "Select rotation"
            default EXAMPLE_LVGL_PORT_ROTATION_0
            config EXAMPLE_LVGL_PORT_ROTATION_0
                bool "Rotation 0"
            config EXAMPLE_LVGL_PORT_ROTATION_90
                bool "Rotation 90"
            config EXAMPLE_LVGL_PORT_ROTATION_180
                bool "Rotation 180"
            config EXAMPLE_LVGL_PORT_ROTATION_270
                bool "Rotation 270"
        endchoice

        config EXAMPLE_LVGL_PORT_ROTATION_DEGREE
            int
            default 0 if EXAMPLE_LVGL_PORT_ROTATION_0
            default 90 if EXAMPLE_LVGL_PORT_ROTATION_90
            default 180 if EXAMPLE_LVGL_PORT_ROTATION_180
            default 270 if EXAMPLE_LVGL_PORT_ROTATION_270

        choice
            depends on !EXAMPLE_LVGL_PORT_AVOID_TEAR_ENABLE
            prompt "Select LVGL buffer memory capability"
            default EXAMPLE_LVGL_PORT_BUF_INTERNAL
            config EXAMPLE_LVGL_PORT_BUF_PSRAM
                bool "PSRAM memory"
            config EXAMPLE_LVGL_PORT_BUF_INTERNAL
                bool "Internal memory"
        endchoice

        config EXAMPLE_LVGL_PORT_BUF_HEIGHT
            depends on !EXAMPLE_LVGL_PORT_AVOID_TEAR_ENABLE
            int "LVGL buffer height"
            default 100
            help
                Height of LVGL buffer. The width of the buffer is the same as that of the LCD.

        menu "Touch Panel"
            config EXAMPLE_I2C_SCL_IO
                int "GT911 I2C SCL GPIO"
                default 9

            config EXAMPLE_I2C_SDA_IO
                int "GT911 I2C SDA GPIO"
                default 8

            config EXAMPLE_PIN_NUM_TOUCH_RST
                int "GT911 reset GPIO (-1 if not used)"
                default -1

            config EXAMPLE_PIN_NUM_TOUCH_INT
                int "GT911 interrupt GPIO (-1 if not used)"
                default -1
endmenu
endmenu

menu "Battery Monitor"
    config BATTERY_DEBUG
        bool "Enable battery monitor debug logging"
        default n
        help
            Enable additional logging for battery monitor readings.
endmenu
endmenu
```
